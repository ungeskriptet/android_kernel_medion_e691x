/*************************
 * Customized Battery Setting dtsi file
*************************/
&bat_comm {
	/* cust_charging.h */

	/* Charging Current Setting */
	usb_charger_current = <50000 >;	/* Unit: 0.01 mA */
	usb_charger_charger_current = <50000>;
	ac_charger_current = <205000 >;	/* Unit: 0.01 mA */
	non_std_ac_charger_current = <205000 >;	/* Unit: 0.01 mA */
	charging_host_charger_current = <65000 >;	/* Unit: 0.01 mA */

	/* charger error check */
	bat_low_temp_protect_enable = <1 >;
	v_charger_enable = <0 >;	/* 1:on , 0:off */
	v_charger_max = <6500 >;	/* unit: mV */
	v_charger_min = <4400 >;
	max_charge_temperature = <50 >;
	min_charge_temperature = <(-5) >;

	/*  Tracking TIME */
	onehundred_percent_tracking_time = <10 >;	/* Unit: second */
	npercent_tracking_time = <20 >;	/* Unit: second */
	sync_to_real_tracking_time = <60 >;	/* Unit: second */
	v_0percent_tracking = <3400 >;	/* Unit: mV */

	/* High battery support */
	high_battery_voltage_support = <1 >;

	/* cust_battery_meter.h */
	/* ADC resistor  */
	r_bat_sense = <4 >;
	r_i_sense = <4 >;
	r_charger_1 = <330 >;
	r_charger_2 = <39 >;
	temperature_t0 = <110 >;
	temperature_t1 = <0 >;
	temperature_t2 = <25 >;
	temperature_t3 = <50 >;
	temperature_t = <255 >;	/* this should be fixed, never change the value */
	fg_meter_resistance = <0 >;
};

&bat_meter {
	/* Qmax for 0mA */
	q_max_pos_50 = <2900 >;
	q_max_pos_25 = <2900 >;
	q_max_pos_0 = <2900 >;
	q_max_neg_10 = <2900 >;
	/* Qmax for 400mA, said high current */
	q_max_pos_50_h_current = <2900 >;
	q_max_pos_25_h_current = <2900 >;
	q_max_pos_0_h_current = <2900 >;
	q_max_neg_10_h_current = <2900 >;
	/* Discharge percentage, 1: D5, 0: D2 */
	oam_d5 = <0 >;

	change_tracking_point = <1 >;
	/* SW OCV tracking setting */
	cust_tracking_point = <1 >;
	cust_r_sense = <200 >;
	cust_hw_cc = <0 >;
	aging_tuning_value = <103 >;
	cust_r_fg_offset = <0 >;
	ocv_board_compesate = <0 >;
	r_fg_board_base = <1000 >;
	r_fg_board_slope = <1000 >;
	car_tune_value = <118 >;

	/* HW Fuel gague  */
	current_detect_r_fg = <10 >;	/* Unit: mA */
	minerroroffset = <1000 >;
	fg_vbat_average_size = <18 >;
	r_fg_value = <10 >;	/* Unit: mOhm */

	cust_poweron_delta_capacity_tolrance = <40 >;
	cust_poweron_low_capacity_tolrance = <5 >;
	cust_poweron_max_vbat_tolrance = <90 >;
	cust_poweron_delta_vbat_tolrance = <30 >;
	cust_poweron_delta_hw_sw_ocv_capacity_tolrance = <10 >;

	/* Fixed battery temperature */
	fixed_tbat_25 = <0 >;
	/* Dynamic change wake up period of battery thread when suspend */
	vbat_normal_wakeup = <3600 >;	/* Unit: mV */
	vbat_low_power_wakeup = <3500 >;	/* Unit: mV */
	normal_wakeup_period = <5400 >;	/* Unit: second */
	low_power_wakeup_period = <300 >;	/* Unit: second */
	close_poweroff_wakeup_period = <30 >;	/* Unit: second */

	rbat_pull_up_r = <16900 >;
	rbat_pull_up_d = <27000 >;
	rbat_pull_up_volt = <1800 >;

	batt_temperature_table_num = <17 >;
	batt_temperature_table = <
	    (-20) 69709
	    (-15) 54633
	    (-10) 43155
	    (-5) 34343
	    0 27523
	    5 22206
	    10 18031
	    15 14730
	    20 12103
	    25 10000
	    30 8306
	    35 6935
	    40 5818
	    45 4904
	    50 4152
	    55 3531
	    60 3016
	>;

	battery_profile_t0_num = <100 >;
	battery_profile_t0 = <
				0   4330
				1   4300
				2   4280
				3   4266
				4   4251
				5   4226
				6   4215
				7   4204
				8   4194
				9   4183
				10  4174
				11  4164
				12  4155
				13  4145
				14  4127
				15  4117
				16  4107
				17  4099
				18  4090
				19  4084
				20  4077
				21  4073
				22  4068
				23  4043
				24  4027
				25  4011
				26  4001
				27  3990
				28  3984
				29  3978
				30  3971
				31  3967
				32  3963
				33  3957
				34  3950
				35  3943
				36  3936
				37  3930
				38  3923
				39  3908
				40  3900
				41  3891
				42  3883
				43  3875
				44  3869
				45  3862
				46  3856
				47  3850
				48  3840
				49  3836
				50  3831
				51  3827
				52  3823
				53  3820
				54  3816
				55  3813
				56  3810
				57  3803
				58  3801
				59  3798
				60  3796
				61  3794
				62  3792
				63  3789
				64  3787
				65  3785
				66  3780
				67  3779
				68  3777
				69  3775
				70  3773
				71  3772
				72  3770
				73  3766
				74  3764
				75  3761
				76  3758
				77  3754
				78  3752
				79  3749
				80  3746
				81  3743
				82  3735
				83  3730
				84  3725
				85  3721
				86  3717
				87  3711
				88  3705
				89  3700
				90  3694
				91  3691
				92  3690
				93  3689
				94  3686
				95  3682
				96  3657
				97  3631
				98  3582
				100 3400 >;

	battery_profile_t1_num = <100 >;
	battery_profile_t1 = <
				0   4330
				1   4300
				2   4280
				3   4266
				4   4251
				5   4226
				6   4215
				7   4204
				8   4194
				9   4183
				10  4174
				11  4164
				12  4155
				13  4145
				14  4127
				15  4117
				16  4107
				17  4099
				18  4090
				19  4084
				20  4077
				21  4073
				22  4068
				23  4043
				24  4027
				25  4011
				26  4001
				27  3990
				28  3984
				29  3978
				30  3971
				31  3967
				32  3963
				33  3957
				34  3950
				35  3943
				36  3936
				37  3930
				38  3923
				39  3908
				40  3900
				41  3891
				42  3883
				43  3875
				44  3869
				45  3862
				46  3856
				47  3850
				48  3840
				49  3836
				50  3831
				51  3827
				52  3823
				53  3820
				54  3816
				55  3813
				56  3810
				57  3803
				58  3801
				59  3798
				60  3796
				61  3794
				62  3792
				63  3789
				64  3787
				65  3785
				66  3780
				67  3779
				68  3777
				69  3775
				70  3773
				71  3772
				72  3770
				73  3766
				74  3764
				75  3761
				76  3758
				77  3754
				78  3752
				79  3749
				80  3746
				81  3743
				82  3735
				83  3730
				84  3725
				85  3721
				86  3717
				87  3711
				88  3705
				89  3700
				90  3694
				91  3691
				92  3690
				93  3689
				94  3686
				95  3682
				96  3657
				97  3631
				98  3582
				100 3400 >;

	battery_profile_t2_num = <100 >;
	battery_profile_t2 = <
				0   4330
				1   4300
				2   4280
				3   4266
				4   4251
				5   4226
				6   4215
				7   4204
				8   4194
				9   4183
				10  4174
				11  4164
				12  4155
				13  4145
				14  4127
				15  4117
				16  4107
				17  4099
				18  4090
				19  4084
				20  4077
				21  4073
				22  4068
				23  4043
				24  4027
				25  4011
				26  4001
				27  3990
				28  3984
				29  3978
				30  3971
				31  3967
				32  3963
				33  3957
				34  3950
				35  3943
				36  3936
				37  3930
				38  3923
				39  3908
				40  3900
				41  3891
				42  3883
				43  3875
				44  3869
				45  3862
				46  3856
				47  3850
				48  3840
				49  3836
				50  3831
				51  3827
				52  3823
				53  3820
				54  3816
				55  3813
				56  3810
				57  3803
				58  3801
				59  3798
				60  3796
				61  3794
				62  3792
				63  3789
				64  3787
				65  3785
				66  3780
				67  3779
				68  3777
				69  3775
				70  3773
				71  3772
				72  3770
				73  3766
				74  3764
				75  3761
				76  3758
				77  3754
				78  3752
				79  3749
				80  3746
				81  3743
				82  3735
				83  3730
				84  3725
				85  3721
				86  3717
				87  3711
				88  3705
				89  3700
				90  3694
				91  3691
				92  3690
				93  3689
				94  3686
				95  3682
				96  3657
				97  3631
				98  3582
				100 3400 >;

	battery_profile_t3_num = <100 >;
	battery_profile_t3 = <
				0   4330
				1   4300
				2   4280
				3   4266
				4   4251
				5   4226
				6   4215
				7   4204
				8   4194
				9   4183
				10  4174
				11  4164
				12  4155
				13  4145
				14  4127
				15  4117
				16  4107
				17  4099
				18  4090
				19  4084
				20  4077
				21  4073
				22  4068
				23  4043
				24  4027
				25  4011
				26  4001
				27  3990
				28  3984
				29  3978
				30  3971
				31  3967
				32  3963
				33  3957
				34  3950
				35  3943
				36  3936
				37  3930
				38  3923
				39  3908
				40  3900
				41  3891
				42  3883
				43  3875
				44  3869
				45  3862
				46  3856
				47  3850
				48  3840
				49  3836
				50  3831
				51  3827
				52  3823
				53  3820
				54  3816
				55  3813
				56  3810
				57  3803
				58  3801
				59  3798
				60  3796
				61  3794
				62  3792
				63  3789
				64  3787
				65  3785
				66  3780
				67  3779
				68  3777
				69  3775
				70  3773
				71  3772
				72  3770
				73  3766
				74  3764
				75  3761
				76  3758
				77  3754
				78  3752
				79  3749
				80  3746
				81  3743
				82  3735
				83  3730
				84  3725
				85  3721
				86  3717
				87  3711
				88  3705
				89  3700
				90  3694
				91  3691
				92  3690
				93  3689
				94  3686
				95  3682
				96  3657
				97  3631
				98  3582
				100 3400 >;

	r_profile_t0_num = <100 >;
	r_profile_t0 = <
				175 4330
				175 4300
				175 4280
				176 4266
				177 4251
				177 4226
				177 4215
				177 4204
				177 4194
				177 4183
				178 4174
				180 4164
				180 4155
				180 4145
				182 4127
				182 4117
				183 4107
				182 4099
				180 4090
				180 4084
				180 4077
				185 4073
				190 4068
				183 4043
				182 4027
				180 4011
				182 4001
				185 3990
				186 3984
				187 3978
				188 3971
				189 3967
				190 3963
				187 3957
				183 3950
				180 3943
				177 3936
				175 3930
				172 3923
				167 3908
				171 3900
				175 3891
				173 3883
				170 3875
				169 3869
				168 3862
				167 3856
				165 3850
				165 3840
				165 3836
				165 3831
				165 3827
				165 3823
				166 3820
				167 3816
				167 3813
				168 3810
				168 3803
				168 3801
				168 3798
				170 3796
				173 3794
				174 3792
				175 3789
				176 3787
				177 3785
				175 3780
				176 3779
				177 3777
				177 3775
				177 3773
				177 3772
				177 3770
				177 3766
				176 3764
				175 3761
				174 3758
				175 3754
				175 3752
				174 3749
				175 3746
				175 3743
				175 3735
				173 3730
				170 3725
				171 3721
				173 3717
				174 3711
				175 3705
				174 3700
				172 3694
				180 3691
				187 3690
				195 3689
				206 3686
				217 3682
				217 3657
				218 3631
				230 3582
				300 3400 >;

	r_profile_t1_num = <100 >;
	r_profile_t1 = <
				175 4330
				175 4300
				175 4280
				176 4266
				177 4251
				177 4226
				177 4215
				177 4204
				177 4194
				177 4183
				178 4174
				180 4164
				180 4155
				180 4145
				182 4127
				182 4117
				183 4107
				182 4099
				180 4090
				180 4084
				180 4077
				185 4073
				190 4068
				183 4043
				182 4027
				180 4011
				182 4001
				185 3990
				186 3984
				187 3978
				188 3971
				189 3967
				190 3963
				187 3957
				183 3950
				180 3943
				177 3936
				175 3930
				172 3923
				167 3908
				171 3900
				175 3891
				173 3883
				170 3875
				169 3869
				168 3862
				167 3856
				165 3850
				165 3840
				165 3836
				165 3831
				165 3827
				165 3823
				166 3820
				167 3816
				167 3813
				168 3810
				168 3803
				168 3801
				168 3798
				170 3796
				173 3794
				174 3792
				175 3789
				176 3787
				177 3785
				175 3780
				176 3779
				177 3777
				177 3775
				177 3773
				177 3772
				177 3770
				177 3766
				176 3764
				175 3761
				174 3758
				175 3754
				175 3752
				174 3749
				175 3746
				175 3743
				175 3735
				173 3730
				170 3725
				171 3721
				173 3717
				174 3711
				175 3705
				174 3700
				172 3694
				180 3691
				187 3690
				195 3689
				206 3686
				217 3682
				217 3657
				218 3631
				230 3582
				300 3400 >;

	r_profile_t2_num = <100 >;
	r_profile_t2 = <
				175 4330
				175 4300
				175 4280
				176 4266
				177 4251
				177 4226
				177 4215
				177 4204
				177 4194
				177 4183
				178 4174
				180 4164
				180 4155
				180 4145
				182 4127
				182 4117
				183 4107
				182 4099
				180 4090
				180 4084
				180 4077
				185 4073
				190 4068
				183 4043
				182 4027
				180 4011
				182 4001
				185 3990
				186 3984
				187 3978
				188 3971
				189 3967
				190 3963
				187 3957
				183 3950
				180 3943
				177 3936
				175 3930
				172 3923
				167 3908
				171 3900
				175 3891
				173 3883
				170 3875
				169 3869
				168 3862
				167 3856
				165 3850
				165 3840
				165 3836
				165 3831
				165 3827
				165 3823
				166 3820
				167 3816
				167 3813
				168 3810
				168 3803
				168 3801
				168 3798
				170 3796
				173 3794
				174 3792
				175 3789
				176 3787
				177 3785
				175 3780
				176 3779
				177 3777
				177 3775
				177 3773
				177 3772
				177 3770
				177 3766
				176 3764
				175 3761
				174 3758
				175 3754
				175 3752
				174 3749
				175 3746
				175 3743
				175 3735
				173 3730
				170 3725
				171 3721
				173 3717
				174 3711
				175 3705
				174 3700
				172 3694
				180 3691
				187 3690
				195 3689
				206 3686
				217 3682
				217 3657
				218 3631
				230 3582
				300 3400 >;

	r_profile_t3_num = <100 >;
	r_profile_t3 = <
				175 4330
				175 4300
				175 4280
				176 4266
				177 4251
				177 4226
				177 4215
				177 4204
				177 4194
				177 4183
				178 4174
				180 4164
				180 4155
				180 4145
				182 4127
				182 4117
				183 4107
				182 4099
				180 4090
				180 4084
				180 4077
				185 4073
				190 4068
				183 4043
				182 4027
				180 4011
				182 4001
				185 3990
				186 3984
				187 3978
				188 3971
				189 3967
				190 3963
				187 3957
				183 3950
				180 3943
				177 3936
				175 3930
				172 3923
				167 3908
				171 3900
				175 3891
				173 3883
				170 3875
				169 3869
				168 3862
				167 3856
				165 3850
				165 3840
				165 3836
				165 3831
				165 3827
				165 3823
				166 3820
				167 3816
				167 3813
				168 3810
				168 3803
				168 3801
				168 3798
				170 3796
				173 3794
				174 3792
				175 3789
				176 3787
				177 3785
				175 3780
				176 3779
				177 3777
				177 3775
				177 3773
				177 3772
				177 3770
				177 3766
				176 3764
				175 3761
				174 3758
				175 3754
				175 3752
				174 3749
				175 3746
				175 3743
				175 3735
				173 3730
				170 3725
				171 3721
				173 3717
				174 3711
				175 3705
				174 3700
				172 3694
				180 3691
				187 3690
				195 3689
				206 3686
				217 3682
				217 3657
				218 3631
				230 3582
				300 3400 >;
};
