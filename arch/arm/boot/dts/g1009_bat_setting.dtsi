/*************************
 * Customized Battery Setting dtsi file
*************************/
&bat_comm {
	/* cust_charging.h */

	/* Charging Current Setting */
	usb_charger_current = <60000 >;	/* Unit: 0.01 mA */
	ac_charger_current = <205000 >;	/* Unit: 0.01 mA */
	non_std_ac_charger_current = <205000 >;	/* Unit: 0.01 mA */
	charging_host_charger_current = <65000 >;	/* Unit: 0.01 mA */

	/* charger error check */
	bat_low_temp_protect_enable = <1 >;
	v_charger_enable = <0 >;	/* 1:on , 0:off */
	v_charger_max = <6500 >;	/* unit: mV */
	v_charger_min = <4400 >;
	max_charge_temperature = <50 >;
	min_charge_temperature = <(-5) >;

	/*  Tracking TIME */
	onehundred_percent_tracking_time = <10 >;	/* Unit: second */
	npercent_tracking_time = <20 >;	/* Unit: second */
	sync_to_real_tracking_time = <60 >;	/* Unit: second */
	v_0percent_tracking = <3400 >;	/* Unit: mV */

	/* High battery support */
	high_battery_voltage_support = <0 >;

	/* cust_battery_meter.h */
	/* ADC resistor  */
	r_bat_sense = <4 >;
	r_i_sense = <4 >;
	r_charger_1 = <330 >;
	r_charger_2 = <39 >;
	temperature_t0 = <110 >;
	temperature_t1 = <0 >;
	temperature_t2 = <25 >;
	temperature_t3 = <50 >;
	temperature_t = <255 >;	/* this should be fixed, never change the value */
	fg_meter_resistance = <0 >;
};

&bat_meter {
	/* Qmax for 0mA */
	q_max_pos_50 = <7020 >;/*6970*/
	q_max_pos_25 = <7020 >;
	q_max_pos_0 = <7020 >;
	q_max_neg_10 = <7020 >;
	/* Qmax for 400mA, said high current */
	q_max_pos_50_h_current = <7020 >;
	q_max_pos_25_h_current = <7020 >;
	q_max_pos_0_h_current = <7020 >;
	q_max_neg_10_h_current = <7020 >;
	/* Discharge percentage, 1: D5, 0: D2 */
	oam_d5 = <0 >;

	change_tracking_point = <1 >;
	/* SW OCV tracking setting */
	cust_tracking_point = <1 >;
	cust_r_sense = <200 >;
	cust_hw_cc = <0 >;
	aging_tuning_value = <103 >;
	cust_r_fg_offset = <0 >;
	ocv_board_compesate = <0 >;
	r_fg_board_base = <1000 >;
	r_fg_board_slope = <1000 >;
	car_tune_value = <100 >;

	/* HW Fuel gague  */
	current_detect_r_fg = <10 >;	/* Unit: mA */
	minerroroffset = <1000 >;
	fg_vbat_average_size = <18 >;
	r_fg_value = <10 >;	/* Unit: mOhm */

	cust_poweron_delta_capacity_tolrance = <80 >;
	cust_poweron_low_capacity_tolrance = <5 >;
	cust_poweron_max_vbat_tolrance = <90 >;
	cust_poweron_delta_vbat_tolrance = <30 >;
	cust_poweron_delta_hw_sw_ocv_capacity_tolrance = <10 >;

	/* Fixed battery temperature */
	fixed_tbat_25 = <0 >;
	/* Dynamic change wake up period of battery thread when suspend */
	vbat_normal_wakeup = <3600 >;	/* Unit: mV */
	vbat_low_power_wakeup = <3500 >;	/* Unit: mV */
	normal_wakeup_period = <5400 >;	/* Unit: second */
	low_power_wakeup_period = <300 >;	/* Unit: second */
	close_poweroff_wakeup_period = <30 >;	/* Unit: second */

	rbat_pull_up_r = <16900 >;
	rbat_pull_up_d = <27000 >;
	rbat_pull_up_volt = <1800 >;

	batt_temperature_table_num = <17 >;
	batt_temperature_table = <
			  (-20) 68237
			  (-15) 53650
			  (-10) 42506
			  (-5) 33892
			  0 27219
			  5 22021
			  10 17926
			  15 14674
			  20 12081
			  25 10000
				30 8315
				35 6948
				40 5834
				45 4917
				50 4161
				55 3535
				60 3014 >;

	battery_profile_t0_num = <100 >;
	battery_profile_t0 = <
				0   4185
				1   4164
				2   4156
				3   4148
				4   4134
				5   4127
				6   4119
				7   4106
				8   4093
				9   4087
				10  4080
				11  4068
				12  4062
				13  4056
				14  4044
				15  4032
				16  4027
				17  4021
				18  4010
				19  4005
				20  4000
				21  3990
				22  3981
				23  3976
				24  3971
				25  3962
				26  3958
				27  3954
				28  3945
				29  3936
				30  3932
				31  3928
				32  3919
				33  3915
				34  3910
				35  3903
				36  3899
				37  3894
				38  3885
				39  3875
				40  3869
				41  3862
				42  3851
				43  3847
				44  3842
				45  3834
				46  3827
				47  3824
				48  3820
				49  3815
				50  3813
				51  3810
				52  3805
				53  3801
				54  3799
				55  3797
				56  3794
				57  3792
				58  3790
				59  3787
				60  3784
				61  3783
				62  3782
				63  3779
				64  3778
				65  3777
				66  3775
				67  3773
				68  3772
				69  3770
				70  3768
				71  3766
				72  3764
				73  3760
				74  3755
				75  3753
				76  3750
				77  3745
				78  3743
				79  3740
				80  3737
				81  3731
				82  3728
				83  3724
				84  3717
				85  3713
				86  3709
				87  3702
				88  3690
				89  3687
				90  3683
				91  3679
				92  3678
				93  3676
				94  3670
				95  3657
				96  3635
				97  3612
				98  3543
				100 3400 >;

	battery_profile_t1_num = <100 >;
	battery_profile_t1 = <
				0   4185
				1   4164
				2   4156
				3   4148
				4   4134
				5   4127
				6   4119
				7   4106
				8   4093
				9   4087
				10  4080
				11  4068
				12  4062
				13  4056
				14  4044
				15  4032
				16  4027
				17  4021
				18  4010
				19  4005
				20  4000
				21  3990
				22  3981
				23  3976
				24  3971
				25  3962
				26  3958
				27  3954
				28  3945
				29  3936
				30  3932
				31  3928
				32  3919
				33  3915
				34  3910
				35  3903
				36  3899
				37  3894
				38  3885
				39  3875
				40  3869
				41  3862
				42  3851
				43  3847
				44  3842
				45  3834
				46  3827
				47  3824
				48  3820
				49  3815
				50  3813
				51  3810
				52  3805
				53  3801
				54  3799
				55  3797
				56  3794
				57  3792
				58  3790
				59  3787
				60  3784
				61  3783
				62  3782
				63  3779
				64  3778
				65  3777
				66  3775
				67  3773
				68  3772
				69  3770
				70  3768
				71  3766
				72  3764
				73  3760
				74  3755
				75  3753
				76  3750
				77  3745
				78  3743
				79  3740
				80  3737
				81  3731
				82  3728
				83  3724
				84  3717
				85  3713
				86  3709
				87  3702
				88  3690
				89  3687
				90  3683
				91  3679
				92  3678
				93  3676
				94  3670
				95  3657
				96  3635
				97  3612
				98  3543
				100 3400 >;

	battery_profile_t2_num = <100 >;
	battery_profile_t2 = <
				0   4185
				1   4164
				2   4156
				3   4148
				4   4134
				5   4127
				6   4119
				7   4106
				8   4093
				9   4087
				10  4080
				11  4068
				12  4062
				13  4056
				14  4044
				15  4032
				16  4027
				17  4021
				18  4010
				19  4005
				20  4000
				21  3990
				22  3981
				23  3976
				24  3971
				25  3962
				26  3958
				27  3954
				28  3945
				29  3936
				30  3932
				31  3928
				32  3919
				33  3915
				34  3910
				35  3903
				36  3899
				37  3894
				38  3885
				39  3875
				40  3869
				41  3862
				42  3851
				43  3847
				44  3842
				45  3834
				46  3827
				47  3824
				48  3820
				49  3815
				50  3813
				51  3810
				52  3805
				53  3801
				54  3799
				55  3797
				56  3794
				57  3792
				58  3790
				59  3787
				60  3784
				61  3783
				62  3782
				63  3779
				64  3778
				65  3777
				66  3775
				67  3773
				68  3772
				69  3770
				70  3768
				71  3766
				72  3764
				73  3760
				74  3755
				75  3753
				76  3750
				77  3745
				78  3743
				79  3740
				80  3737
				81  3731
				82  3728
				83  3724
				84  3717
				85  3713
				86  3709
				87  3702
				88  3690
				89  3687
				90  3683
				91  3679
				92  3678
				93  3676
				94  3670
				95  3657
				96  3635
				97  3612
				98  3543
				100 3400 >;

	battery_profile_t3_num = <100 >;
	battery_profile_t3 = <
				0   4185
				1   4164
				2   4156
				3   4148
				4   4134
				5   4127
				6   4119
				7   4106
				8   4093
				9   4087
				10  4080
				11  4068
				12  4062
				13  4056
				14  4044
				15  4032
				16  4027
				17  4021
				18  4010
				19  4005
				20  4000
				21  3990
				22  3981
				23  3976
				24  3971
				25  3962
				26  3958
				27  3954
				28  3945
				29  3936
				30  3932
				31  3928
				32  3919
				33  3915
				34  3910
				35  3903
				36  3899
				37  3894
				38  3885
				39  3875
				40  3869
				41  3862
				42  3851
				43  3847
				44  3842
				45  3834
				46  3827
				47  3824
				48  3820
				49  3815
				50  3813
				51  3810
				52  3805
				53  3801
				54  3799
				55  3797
				56  3794
				57  3792
				58  3790
				59  3787
				60  3784
				61  3783
				62  3782
				63  3779
				64  3778
				65  3777
				66  3775
				67  3773
				68  3772
				69  3770
				70  3768
				71  3766
				72  3764
				73  3760
				74  3755
				75  3753
				76  3750
				77  3745
				78  3743
				79  3740
				80  3737
				81  3731
				82  3728
				83  3724
				84  3717
				85  3713
				86  3709
				87  3702
				88  3690
				89  3687
				90  3683
				91  3679
				92  3678
				93  3676
				94  3670
				95  3657
				96  3635
				97  3612
				98  3543
				100 3400 >;

	r_profile_t0_num = <100 >;
	r_profile_t0 = <
				103 4185
				103 4164
				104 4156
				105 4148
				107 4134
				106 4127
				105 4119
				107 4106
				105 4093
				105 4087
				105 4080
				107 4068
				107 4062
				107 4056
				107 4044
				107 4032
				107 4027
				108 4021
				108 4010
				109 4005
				110 4000
				113 3990
				117 3981
				117 3976
				118 3971
				118 3962
				120 3958
				122 3954
				123 3945
				123 3936
				124 3932
				125 3928
				128 3919
				128 3915
				128 3910
				130 3903
				130 3899
				130 3894
				130 3885
				128 3875
				126 3869
				123 3862
				118 3851
				118 3847
				118 3842
				115 3834
				113 3827
				113 3824
				113 3820
				110 3815
				110 3813
				110 3810
				110 3805
				110 3801
				110 3799
				110 3797
				112 3794
				112 3792
				112 3790
				112 3787
				112 3784
				112 3783
				113 3782
				113 3779
				114 3778
				115 3777
				117 3775
				117 3773
				117 3772
				117 3770
				118 3768
				118 3766
				117 3764
				115 3760
				113 3755
				113 3753
				113 3750
				113 3745
				113 3743
				113 3740
				117 3737
				115 3731
				115 3728
				115 3724
				117 3717
				117 3713
				117 3709
				120 3702
				118 3690
				120 3687
				122 3683
				123 3679
				125 3678
				128 3676
				135 3670
				142 3657
				141 3635
				140 3612
				152 3543
				170 3400 >;

	r_profile_t1_num = <100 >;
	r_profile_t1 = <
				103 4185
				103 4164
				104 4156
				105 4148
				107 4134
				106 4127
				105 4119
				107 4106
				105 4093
				105 4087
				105 4080
				107 4068
				107 4062
				107 4056
				107 4044
				107 4032
				107 4027
				108 4021
				108 4010
				109 4005
				110 4000
				113 3990
				117 3981
				117 3976
				118 3971
				118 3962
				120 3958
				122 3954
				123 3945
				123 3936
				124 3932
				125 3928
				128 3919
				128 3915
				128 3910
				130 3903
				130 3899
				130 3894
				130 3885
				128 3875
				126 3869
				123 3862
				118 3851
				118 3847
				118 3842
				115 3834
				113 3827
				113 3824
				113 3820
				110 3815
				110 3813
				110 3810
				110 3805
				110 3801
				110 3799
				110 3797
				112 3794
				112 3792
				112 3790
				112 3787
				112 3784
				112 3783
				113 3782
				113 3779
				114 3778
				115 3777
				117 3775
				117 3773
				117 3772
				117 3770
				118 3768
				118 3766
				117 3764
				115 3760
				113 3755
				113 3753
				113 3750
				113 3745
				113 3743
				113 3740
				117 3737
				115 3731
				115 3728
				115 3724
				117 3717
				117 3713
				117 3709
				120 3702
				118 3690
				120 3687
				122 3683
				123 3679
				125 3678
				128 3676
				135 3670
				142 3657
				141 3635
				140 3612
				152 3543
				170 3400 >;

	r_profile_t2_num = <100 >;
	r_profile_t2 = <
				103 4185
				103 4164
				104 4156
				105 4148
				107 4134
				106 4127
				105 4119
				107 4106
				105 4093
				105 4087
				105 4080
				107 4068
				107 4062
				107 4056
				107 4044
				107 4032
				107 4027
				108 4021
				108 4010
				109 4005
				110 4000
				113 3990
				117 3981
				117 3976
				118 3971
				118 3962
				120 3958
				122 3954
				123 3945
				123 3936
				124 3932
				125 3928
				128 3919
				128 3915
				128 3910
				130 3903
				130 3899
				130 3894
				130 3885
				128 3875
				126 3869
				123 3862
				118 3851
				118 3847
				118 3842
				115 3834
				113 3827
				113 3824
				113 3820
				110 3815
				110 3813
				110 3810
				110 3805
				110 3801
				110 3799
				110 3797
				112 3794
				112 3792
				112 3790
				112 3787
				112 3784
				112 3783
				113 3782
				113 3779
				114 3778
				115 3777
				117 3775
				117 3773
				117 3772
				117 3770
				118 3768
				118 3766
				117 3764
				115 3760
				113 3755
				113 3753
				113 3750
				113 3745
				113 3743
				113 3740
				117 3737
				115 3731
				115 3728
				115 3724
				117 3717
				117 3713
				117 3709
				120 3702
				118 3690
				120 3687
				122 3683
				123 3679
				125 3678
				128 3676
				135 3670
				142 3657
				141 3635
				140 3612
				152 3543
				170 3400 >;

	r_profile_t3_num = <100 >;
	r_profile_t3 = <
				103 4185
				103 4164
				104 4156
				105 4148
				107 4134
				106 4127
				105 4119
				107 4106
				105 4093
				105 4087
				105 4080
				107 4068
				107 4062
				107 4056
				107 4044
				107 4032
				107 4027
				108 4021
				108 4010
				109 4005
				110 4000
				113 3990
				117 3981
				117 3976
				118 3971
				118 3962
				120 3958
				122 3954
				123 3945
				123 3936
				124 3932
				125 3928
				128 3919
				128 3915
				128 3910
				130 3903
				130 3899
				130 3894
				130 3885
				128 3875
				126 3869
				123 3862
				118 3851
				118 3847
				118 3842
				115 3834
				113 3827
				113 3824
				113 3820
				110 3815
				110 3813
				110 3810
				110 3805
				110 3801
				110 3799
				110 3797
				112 3794
				112 3792
				112 3790
				112 3787
				112 3784
				112 3783
				113 3782
				113 3779
				114 3778
				115 3777
				117 3775
				117 3773
				117 3772
				117 3770
				118 3768
				118 3766
				117 3764
				115 3760
				113 3755
				113 3753
				113 3750
				113 3745
				113 3743
				113 3740
				117 3737
				115 3731
				115 3728
				115 3724
				117 3717
				117 3713
				117 3709
				120 3702
				118 3690
				120 3687
				122 3683
				123 3679
				125 3678
				128 3676
				135 3670
				142 3657
				141 3635
				140 3612
				152 3543
				170 3400 >;
};
